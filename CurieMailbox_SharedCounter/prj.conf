## prj.conf
```kconfig
CONFIG_IPM=y
CONFIG_IPM_QUARK_SE=y
CONFIG_IPM_QUARK_SE_MASTER=y
CONFIG_IPM_CONSOLE_RECEIVER=y
CONFIG_STDOUT_CONSOLE=y
CONFIG_GPIO=y
CONFIG_ARC_INIT=n
CONFIG_USB=y
CONFIG_USB_DW=y
CONFIG_USB_DEVICE_STACK=y
CONFIG_USB_CDC_ACM=y
CONFIG_SERIAL=y
CONFIG_UART_INTERRUPT_DRIVEN=y
CONFIG_UART_LINE_CTRL=y
CONFIG_COMPILER_OPT="-O0"
CONFIG_GPIO_QMSI=y
```

## src/shared_counter.c
```c
/*
 * Copyright (c) 2016 Intel Corporation
 *
 * Licensed under the Apache License, Version 2.0 (the "License");
 * you may not use this file except in compliance with the License.
 * You may obtain a copy of the License at
 *
 *     http://www.apache.org/licenses/LICENSE-2.0
 *
 * Unless required by applicable law or agreed to in writing, software
 * distributed under the License is distributed on an "AS IS" BASIS,
 * WITHOUT WARRANTIES OR CONDITIONS OF ANY KIND, either express or implied.
 * See the License for the specific language governing permissions and
 * limitations under the License.
 */


#include <zephyr.h>
#include <ipm.h>
#include <ipm/ipm_quark_se.h>
#include "arduino101_services/arduino101_services.h"

/* Sending messages on channel 1 */
QUARK_SE_IPM_DEFINE(ipm_send, 1, QUARK_SE_IPM_OUTBOUND);

/* Receiving messages on channel 0 */
QUARK_SE_IPM_DEFINE(ipm_receive, 0, QUARK_SE_IPM_INBOUND);

static struct device *ipm;
static struct device *rec_ipm;
static volatile uint32_t val;
static volatile bool received;

void ipm_callback(void *context, uint32_t id, volatile void *data)
{
	uint32_t *udata = (uint32_t *)data;
    val = *udata + 1;
    received = true;
}

void main (void)
{
    received = false;
    ipm = device_get_binding("ipm_send");
	rec_ipm = device_get_binding("ipm_receive");
	ipm_register_callback(rec_ipm, ipm_callback, NULL);
	ipm_set_enabled(rec_ipm, 1);

    while (1) {
        if (received) {
            received = false;
            ipm_send(ipm, 1, 0, (uint32_t *)&val, sizeof(uint32_t));
        }

        task_yield();
    }
}
```

## src/sketch.c
```c
/*
 * Copyright (c) 2016 Intel Corporation
 *
 * Licensed under the Apache License, Version 2.0 (the "License");
 * you may not use this file except in compliance with the License.
 * You may obtain a copy of the License at
 *
 *     http://www.apache.org/licenses/LICENSE-2.0
 *
 * Unless required by applicable law or agreed to in writing, software
 * distributed under the License is distributed on an "AS IS" BASIS,
 * WITHOUT WARRANTIES OR CONDITIONS OF ANY KIND, either express or implied.
 * See the License for the specific language governing permissions and
 * limitations under the License.
 */


#include <zephyr.h>
#include <ipm.h>
#include <ipm/ipm_quark_se.h>

/* Sending messages on channel 1 */
QUARK_SE_IPM_DEFINE(ipm_send, 1, QUARK_SE_IPM_OUTBOUND);

/* Receiving messages on channel 0 */
QUARK_SE_IPM_DEFINE(ipm_receive, 0, QUARK_SE_IPM_INBOUND);

static struct device *ipm;
static struct device *rec_ipm;
static volatile uint32_t val;
static volatile bool received;

void ipm_callback(void *context, uint32_t id, volatile void *data)
{
	uint32_t *udata = (uint32_t *)data;
    val = *udata + 1;
    received = true;
}

void sketch (void *dummy1, void *dummy2, void *dummy3)
{
    received = false;
    ipm = device_get_binding("ipm_send");
	rec_ipm = device_get_binding("ipm_receive");
	ipm_register_callback(rec_ipm, ipm_callback, NULL);
	ipm_set_enabled(rec_ipm, 1);

    while (1) {
        if (received) {
            received = false;
            ipm_send(ipm, 1, 0, (uint32_t *)&val, sizeof(uint32_t));
        }

        k_yield();
    }
}
```
