## prj.conf
```kconfig
CONFIG_STDOUT_CONSOLE=y
CONFIG_GPIO=y
CONFIG_ARC_INIT=n
CONFIG_USB=y
CONFIG_USB_DW=y
CONFIG_USB_DEVICE_STACK=y
CONFIG_USB_CDC_ACM=y
CONFIG_SERIAL=y
CONFIG_UART_INTERRUPT_DRIVEN=y
CONFIG_UART_LINE_CTRL=y
CONFIG_COMPILER_OPT="-O0"
CONFIG_GPIO_QMSI=y
CONFIG_PWM=y
CONFIG_PWM_QMSI_NUM_PORTS=4
CONFIG_NANO_TIMERS=y
CONFIG_NANO_TIMEOUTS=y
CONFIG_PINMUX_DEV_QMSI=y
CONFIG_PINMUX_DEV=y
CONFIG_PINMUX=y
CONFIG_GPIO_QMSI_1_NAME="GPIO_1"
CONFIG_GPIO_QMSI_1_PRI=2
CONFIG_USB_CDC_ACM_CONFIGURABLE=y
CONFIG_PHYS_RAM_ADDR=0xA8001000
CONFIG_RAM_SIZE=36
CONFIG_ROM_SIZE=144
```

## src/sketch.c
```c
/*
 * Copyright (c) 2016 Intel Corporation
 *
 * Licensed under the Apache License, Version 2.0 (the "License");
 * you may not use this file except in compliance with the License.
 * You may obtain a copy of the License at
 *
 *     http://www.apache.org/licenses/LICENSE-2.0
 *
 * Unless required by applicable law or agreed to in writing, software
 * distributed under the License is distributed on an "AS IS" BASIS,
 * WITHOUT WARRANTIES OR CONDITIONS OF ANY KIND, either express or implied.
 * See the License for the specific language governing permissions and
 * limitations under the License.
 */

#include <zephyr.h>
#include "arduino/arduino.h"
#include "arduino101_services/arduino101_services.h"

void sketch (void *dummy1, void *dummy2, void *dummy3)
{
    // Required for Arduino-like functionality on x86
    variantInit();

	//setup

	//loop
	while(1)
	{
		for(int i = 0; i < smc_availableForRead(); i++)
		{
			smc_write(smc_read() * 2);
		}
		k_yield();
	}
}
```

## src/smc.c
```c
/*
 * Copyright (c) 2016 Intel Corporation
 *
 * Licensed under the Apache License, Version 2.0 (the "License");
 * you may not use this file except in compliance with the License.
 * You may obtain a copy of the License at
 *
 *     http://www.apache.org/licenses/LICENSE-2.0
 *
 * Unless required by applicable law or agreed to in writing, software
 * distributed under the License is distributed on an "AS IS" BASIS,
 * WITHOUT WARRANTIES OR CONDITIONS OF ANY KIND, either express or implied.
 * See the License for the specific language governing permissions and
 * limitations under the License.
 */

#include <zephyr.h>
#include "arduino/arduino.h"
#include "arduino101_services/sharedmemory_com.h"

void main (void)
{
    // Required for Arduino-like functionality on x86
    variantInit();

	//setup

	//loop
	while(1)
	{
		for(int i = 0; i < smc_availableForRead(); i++)
		{
			smc_write(smc_read() * 2);
		}
		task_yield();
	}
}
```
